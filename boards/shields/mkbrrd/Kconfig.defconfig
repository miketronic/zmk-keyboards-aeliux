## boards/shields/mkbrrd/Kconfig.defconfig
```kconfig
# Copyright (c) 2025 The ZMK Contributors
# SPDX-License-Identifier: MIT

if SHIELD_MKBRRD
  
config ZMK_KEYBOARD_NAME
    default "MKBRRD Core Keyboard"

endif
```

## boards/shields/mkbrrd/Kconfig.shield
```kconfig
# Copyright (c) 2025 The ZMK Contributors
# SPDX-License-Identifier: MIT

config SHIELD_MKBRRD
    def_bool $(shields_list_contains,mkbrrd)
```
